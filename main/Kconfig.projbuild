## main/Kconfig.projbuild
```kconfig
menu "LilyGo Display Product Configuration"
    choice LILYGO_DISPLAY_BOARD
        prompt "LilyGo Display Board"
        default LILYGO_T_DISPLAY_S3_AMOLED

        help
            Select LilyGo Display Product

        config LILYGO_T_AMOLED_LITE_147
            bool "T-Display AMOLED Lite 1.47 Inch"
            
        config LILYGO_T_DISPLAY_S3_AMOLED
            bool "T-Display S3 AMOLED 1.91"

        config LILYGO_T_DISPLAY_S3_AMOLED_TOUCH
            bool "T-Display S3 AMOLED 1.91 Inch with Touch"

        config LILYGO_T4_S3_241
            bool "T4 S3 AMOLED 2.41 Inch with Touch"

        config LILYGO_T_TRACK_102
            bool "T-Track 1.02 Inch"

        config LILYGO_T_QT_S3
            bool "T-QT S3 0.9"

        config LILYGO_T_DISPLAY
            bool "T-Display 1.4 Inch"

        config LILYGO_T_DISPLAY_S3
            bool "T-Display S3 1.9 Inch"

        config LILYGO_T_DISPLAY_S3_PRO
            bool "T-Display S3 Pro 2.33 Inch"

        config LILYGO_T_DONGLE_S2
            bool "T-Dongle S2 1.14 Inch"

        config LILYGO_T_DONGLE_S3
            bool "T-Dongle S3 0.96 Inch"

        config LILYGO_T_DISPLAY_LONG
            bool "T-Display Long 3.4 Inch"
    
        config LILYGO_T_HMI
            bool "T-HMI 2.8 Inch"

        config LILYGO_T_QT_C6
            bool "T-QT C6 0.85 Inch"

        config LILYGO_T_RGB
            bool "T-RGB 2.1 or 2.8 Inch"

        config LILYGO_T_WATCH_S3
            bool "T-Watch S3"
                        
    
    endchoice

    choice LVGL_DEMO
        prompt "GUI Demo"
        default USE_DEMO_WIDGETS

        help
            Select LilyGo Display Product

        config USE_DEMO_WIDGETS
            bool "lvgl Show some widget demo"
        config USE_DEMO_BENCHMARK
            bool "lvgl Benchmark your system demo"
        config USE_DEMO_STRESS
            bool "lvgl Stress test demo"
        config USE_DEMO_MUSIC
            bool "lvgl Music player demo"
    endchoice

endmenu
```

## sdkconfig.defaults.t-display
```kconfig
CONFIG_LILYGO_T_DISPLAY=y
CONFIG_LV_USE_USER_DATA=y
CONFIG_LV_COLOR_16_SWAP=y
CONFIG_LV_COLOR_DEPTH_16=y
CONFIG_IDF_TARGET="esp32"
CONFIG_IDF_TARGET_ESP32=y
CONFIG_ESP_CONSOLE_USB_SERIAL_JTAG=y
CONFIG_ESP_DEFAULT_CPU_FREQ_MHZ_240=y
CONFIG_ESP_DEFAULT_CPU_FREQ_MHZ=240
CONFIG_LV_MEM_SIZE_KILOBYTES=48
CONFIG_LV_USE_DEMO_WIDGETS=y
CONFIG_LV_USE_DEMO_BENCHMARK=y
CONFIG_LV_USE_DEMO_STRESS=y
CONFIG_LV_USE_DEMO_MUSIC=y
CONFIG_LV_FONT_MONTSERRAT_12=y
CONFIG_LV_FONT_MONTSERRAT_14=y
CONFIG_LV_FONT_MONTSERRAT_16=y
CONFIG_LV_FONT_MONTSERRAT_18=y
CONFIG_LV_FONT_MONTSERRAT_20=y
CONFIG_LV_FONT_MONTSERRAT_22=y
CONFIG_LV_FONT_MONTSERRAT_24=y
CONFIG_LV_FONT_MONTSERRAT_26=y
CONFIG_LV_FONT_MONTSERRAT_28=y
CONFIG_LV_FONT_MONTSERRAT_30=y
CONFIG_LV_FONT_MONTSERRAT_32=y
CONFIG_LV_FONT_MONTSERRAT_34=y
CONFIG_LV_FONT_MONTSERRAT_36=y
CONFIG_LV_FONT_MONTSERRAT_38=y
CONFIG_LV_FONT_MONTSERRAT_40=y
CONFIG_LV_FONT_MONTSERRAT_42=y
CONFIG_LV_FONT_MONTSERRAT_44=y
CONFIG_LV_FONT_MONTSERRAT_46=y
CONFIG_LV_FONT_MONTSERRAT_48=y
CONFIG_LV_FONT_DEFAULT_MONTSERRAT_14=y
```

## sdkconfig.defaults.t-rgb
```kconfig
CONFIG_LILYGO_T_RGB=y
CONFIG_LV_USE_USER_DATA=y
CONFIG_LV_COLOR_16_SWAP=n
CONFIG_LV_COLOR_DEPTH_16=y
CONFIG_IDF_TARGET="esp32s3"
CONFIG_IDF_TARGET_ESP32S3=y
CONFIG_SPIRAM=y
CONFIG_SPIRAM_MODE_OCT=y
CONFIG_SPIRAM_TYPE_AUTO=y
CONFIG_ESP_CONSOLE_USB_SERIAL_JTAG=y
CONFIG_ESP_DEFAULT_CPU_FREQ_MHZ_240=y
CONFIG_ESP_DEFAULT_CPU_FREQ_MHZ=240
CONFIG_ESPTOOLPY_FLASHSIZE_16MB=y
CONFIG_LV_MEM_SIZE_KILOBYTES=48
CONFIG_LV_USE_DEMO_WIDGETS=y
CONFIG_LV_USE_DEMO_BENCHMARK=y
CONFIG_LV_USE_DEMO_STRESS=y
CONFIG_LV_USE_DEMO_MUSIC=y
CONFIG_LV_FONT_MONTSERRAT_12=y
CONFIG_LV_FONT_MONTSERRAT_14=y
CONFIG_LV_FONT_MONTSERRAT_16=y
CONFIG_LV_FONT_MONTSERRAT_18=y
CONFIG_LV_FONT_MONTSERRAT_20=y
CONFIG_LV_FONT_MONTSERRAT_22=y
CONFIG_LV_FONT_MONTSERRAT_24=y
CONFIG_LV_FONT_MONTSERRAT_26=y
CONFIG_LV_FONT_MONTSERRAT_28=y
CONFIG_LV_FONT_MONTSERRAT_30=y
CONFIG_LV_FONT_MONTSERRAT_32=y
CONFIG_LV_FONT_MONTSERRAT_34=y
CONFIG_LV_FONT_MONTSERRAT_36=y
CONFIG_LV_FONT_MONTSERRAT_38=y
CONFIG_LV_FONT_MONTSERRAT_40=y
CONFIG_LV_FONT_MONTSERRAT_42=y
CONFIG_LV_FONT_MONTSERRAT_44=y
CONFIG_LV_FONT_MONTSERRAT_46=y
CONFIG_LV_FONT_MONTSERRAT_48=y
CONFIG_LV_FONT_DEFAULT_MONTSERRAT_14=y
```
